// local custom config
#define MIRYOKU_NAV_VI
#define XXX &none

#define MIRYOKU_LAYOUTMAPPING_DACTYL_MANUFORM_5X6( \
K00, K01, K02, K03, K04,                         K05, K06, K07, K08, K09, \
K10, K11, K12, K13, K14,                         K15, K16, K17, K18, K19, \
K20, K21, K22, K23, K24,                         K25, K26, K27, K28, K29, \
N30, N31, K32, K33, K34,                         K35, K36, K37, N38, N39 \
) \
XXX XXX  XXX  XXX  XXX        XXX                                XXX  XXX  XXX  XXX  XXX XXX \
XXX K00  K01  K02  K03        K04                                K05  K06  K07  K08  K09 XXX \
XXX K10  K11  K12  K13        K14                                K15  K16  K17  K18  K19 XXX \
XXX K20  K21  K22  K23        K24                                K25  K26  K27  K28  K29 XXX \
    XXX  XXX                                                                    XXX  XXX \
               K32  K33       K34                                K37 \
                    &kp BSPC  &kp DEL            &kp SPACE  K35  K36

#define MIRYOKU_LAYERMAPPING_BASE( \
K00, K01, K02, K03, K04,                         K05, K06, K07, K08, K09, \
K10, K11, K12, K13, K14,                         K15, K16, K17, K18, K19, \
K20, K21, K22, K23, K24,                         K25, K26, K27, K28, K29, \
N30, N31, K32, K33, K34,                         K35, K36, K37, N38, N39 \
) \
&kp GRAVE   &kp N1    &kp N2    &kp N3  &kp N4    &kp N5                                  &kp N6      &kp N7  &kp N8  &kp N9    &kp N0    &kp MINUS \
&kp TAB     K00       K01       K02     K03       K04                                     K05         K06     K07     K08       &kp SEMI  &kp BSLH \
&caps_word  K10       K11       K12     K13       K14                                     K15         K16     K17     K18       K19       &kp APOS \
&kp LSHIFT  K20       K21       K22     K23       K24                                     K25         K26     K27     K28       K29       &kp EQUAL \
            &kp LPAR  &kp RPAR                                                                                        &kp LBKT  &kp RBKT \
                                        K32       K33     K34                                K37 \
                                        &kp BSPC          &kp DEL            &kp SPACE  K35  K36

#define MIRYOKU_LAYERMAPPING_TAP( \
K00, K01, K02, K03, K04,                         K05, K06, K07, K08, K09, \
K10, K11, K12, K13, K14,                         K15, K16, K17, K18, K19, \
K20, K21, K22, K23, K24,                         K25, K26, K27, K28, K29, \
N30, N31, K32, K33, K34,                         K35, K36, K37, N38, N39 \
) \
&kp GRAVE   &kp N1    &kp N2    &kp N3  &kp N4  &kp N5                                      &kp N6      &kp N7  &kp N8  &kp N9    &kp N0    &kp MINUS \
&kp TAB     K00       K01       K02     K03     K04                                         K05         K06     K07     K08       &kp SEMI  &kp BSLH \
&to U_BASE  K10       K11       K12     K13     K14                                         K15         K16     K17     K18       K19       &kp APOS \
&kp LSHIFT  K20       K21       K22     K23     K24                                         K25         K26     K27     K28       K29       &kp EQUAL \
            &kp LPAR  &kp RPAR                                                                                          &kp LBKT  &kp RBKT \
                                        K32     K33     K34                                 K37 \
                                        &kp BSPC        &kp DEL             &kp SPACE  K35  K36


#include "./miryoku/dactyl_manuform_5x6.h"
#include "../miryoku_zmk/miryoku/miryoku.dtsi"

